## arch/arm64/hotplug/Kconfig
```kconfig
config HIMA_HOTPLUG
        bool "Enable hima-hotplug cpu hotplug driver"
	depends on STATE_NOTIFIER
        default n
        help
          Generic cpu hotplugging driver for ARM SOCs

config ALUCARD_HOTPLUG
	bool "Enable alucard-hotplug cpu hotplug driver"
 	default n
 	help
 	  Generic Alucard-hotplug cpu hotplug driver for ARM SOCs
```

## drivers/clk/msm/Kconfig
```kconfig
config MSM_CLK_CONTROLLER_V2
	bool "QTI clock driver"
	---help---
	   Generate clock data structures from definitions found in
	   device tree.

config PVS_LEVEL_INTERFACE
	bool "Expose PVS level information"
	help
		Allow PVS level to be shown

source "drivers/clk/msm/mdss/Kconfig"
```
